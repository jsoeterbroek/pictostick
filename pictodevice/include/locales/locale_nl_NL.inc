
#include "_locale.h"
#include <Arduino.h>

// WIFI
const char *TXT_WIFI_EXCELLENT     = "Uitstekend";
const char *TXT_WIFI_GOOD          = "Goed";
const char *TXT_WIFI_FAIR          = "Redelijk";
const char *TXT_WIFI_WEAK          = "Zwak";
const char *TXT_WIFI_NO_CONNECTION = "Geen Verbinding";

// WIFI STATUS
const char *TXT_WL_NO_SHIELD       = "No Shield";
const char *TXT_WL_IDLE_STATUS     = "Idle";
const char *TXT_WL_NO_SSID_AVAIL   = "No SSID Available";
const char *TXT_WL_SCAN_COMPLETED  = "Scan Complete";
const char *TXT_WL_CONNECTED       = "Connected";
const char *TXT_WL_CONNECT_FAILED  = "Connection Failed";
const char *TXT_WL_CONNECTION_LOST = "Connection Lost";
const char *TXT_WL_DISCONNECTED    = "Disconnected";

// WIFI MANAGER
const char *TXT_WM_START = "Starten WiFiManager";
const char *TXT_WM_WEBPORTAL_STARTED = "Webportaal gestart op: ";
const char *TXT_WM_CONNECT_SSID = "Verbind met WiFi SSID: ";
const char *TXT_WM_WITH_PASSWORD = "met wachtwoord 'password' om WiFi";
const char *TXT_WM_CONFIG_DEVICE = "voor dit apparaat te configureren.";

// Device modes
const char *TXT_DM_SELECT = "Selecteer apparaat modus: ";
const char *TXT_DM_NET_CONF = "WiFi configuratie";
const char *TXT_DM_PICTO_UPD = "Picto serie update";
const char *TXT_DM_NORMAL_MODE = "Normale modus";
const char *TXT_DM_SET_1 = "Apparaat modus 1";
const char *TXT_DM_SET_2 = "Apparaat modus 2";
const char *TXT_DM_SET_3 = "Apparaat modus 3";
const char *TXT_DM_RESTART = "Herstart apparaat";

// device mode 2
const char *TXT_DM2 = "Apparaat modus 2";
const char *TXT_DM2_WIFI_START = "Starten WiFi";
const char *TXT_DM2_WS_START = "Starten Webserver";
const char *TXT_DM2_FILE_WAITING = "Wachten op bestand upload...";
const char *TXT_DM2_FILE_OK = "Bestand upload OK ";
const char *TXT_DM2_FILE_ERR = "Bestand upload foutmelding ";
const char *TXT_DM2_WIFI_DISC = "Stoppen WiFi ";

// device mode 1
const char *TXT_DM1 = "Apparaat modus 1";