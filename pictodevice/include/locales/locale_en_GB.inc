#include "_locale.h"
#include <Arduino.h>

// WIFI
const char *TXT_WIFI_EXCELLENT     = "Excellent";
const char *TXT_WIFI_GOOD          = "Good";
const char *TXT_WIFI_FAIR          = "Fair";
const char *TXT_WIFI_WEAK          = "Weak";
const char *TXT_WIFI_NO_CONNECTION = "No Connection";

// WIFI STATUS
const char *TXT_WL_NO_SHIELD       = "No Shield";
const char *TXT_WL_IDLE_STATUS     = "Idle";
const char *TXT_WL_NO_SSID_AVAIL   = "No SSID Available";
const char *TXT_WL_SCAN_COMPLETED  = "Scan Complete";
const char *TXT_WL_CONNECTED       = "Connected";
const char *TXT_WL_CONNECT_FAILED  = "Connection Failed";
const char *TXT_WL_CONNECTION_LOST = "Connection Lost";
const char *TXT_WL_DISCONNECTED    = "Disconnected";

// WIFI MANAGER
const char *TXT_WM_START = "Starting WiFiManager";
const char *TXT_WM_WEBPORTAL_STARTED = "Webportal started at: ";
const char *TXT_WM_CONNECT_SSID = "Please connect to WiFi SSID: ";
const char *TXT_WM_WITH_PASSWORD = "with password 'password' to";
const char *TXT_WM_CONFIG_DEVICE = "configure WiFI for this device.";

// Device modes
const char *TXT_DM_SELECT = "Select device mode: ";
const char *TXT_DM_NET_CONF = "WiFi configuration";
const char *TXT_DM_PICTO_UPD = "Picto sequence update";
const char *TXT_DM_USER_CONF = "User configuration";
const char *TXT_DM_NORMAL_MODE = "Normal mode";
const char *TXT_DM_SET_1 = "Setting device mode 1";
const char *TXT_DM_SET_2 = "Setting device mode 2";
const char *TXT_DM_SET_3 = "Setting device mode 3";
const char *TXT_DM_SET_4 = "Setting device mode 4";
const char *TXT_DM_RESTART = "Restart device";

// device mode 1
const char *TXT_DM1 = "device mode 1";

// device mode 2
const char *TXT_DM2 = "device mode 2";
const char *TXT_DM2_WIFI_START = "Starting WiFi";
const char *TXT_DM2_WS_START = "Starting Webserver";
const char *TXT_DM2_FILE_WAITING = "Waiting for file upload... ";
const char *TXT_DM2_FILE_OK = "Dile upload OK ";
const char *TXT_DM2_FILE_ERR = "ERROR: file upload failed ";
const char *TXT_DM2_WIFI_DISC = "Disconnect WiFi ";

// device mode 3
const char *TXT_DM3 = "device mode 3";
const char *TXT_DM3_SAVE = "Save";